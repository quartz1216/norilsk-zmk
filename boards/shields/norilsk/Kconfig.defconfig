## boards/shields/norilsk/Kconfig.defconfig
```kconfig
# Copyright (c) 2026 The ZMK Contributors
# SPDX-License-Identifier: MIT

if SHIELD_NORILSK

config ZMK_KEYBOARD_NAME
    default "Norilsk"

endif
```

## boards/shields/norilsk/Kconfig.shield
```kconfig
# Copyright (c) 2026 The ZMK Contributors
# SPDX-License-Identifier: MIT

config SHIELD_NORILSK
    def_bool $(shields_list_contains,norilsk)
```
